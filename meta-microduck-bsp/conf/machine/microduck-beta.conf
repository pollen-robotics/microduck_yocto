## meta-microduck-distro/conf/layer.conf
```bitbake
BBPATH .= ":${LAYERDIR}"

BBFILE_COLLECTIONS += "microduck-distro"
BBFILE_PATTERN_microduck-distro := "^${LAYERDIR}/"
BBFILE_PRIORITY_microduck-distro = "20"
# Configuration only, no recipes.
BBFILE_PATTERN_IGNORE_EMPTY_microduck-distro = "1"

LAYERVERSION_microduck-distro = "1"
LAYERDEPENDS_microduck-distro = "core"
LAYERSERIES_COMPAT_microduck-distro = "wrynose"
```
